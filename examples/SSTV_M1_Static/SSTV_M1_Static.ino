// So the precalculated values will get stored
#define DDS_REFCLK_DEFAULT (34965/2)

#include <HamShield.h>

#define PWM_PIN 3
#define RESET_PIN A3
#define SWITCH_PIN 2

HamShield radio;
DDS dds;
// Defined at the end of the sketch
extern const uint16_t image[256*20] PROGMEM;

#define F_1200 0
#define F_1500 1
#define F_2400 2
ddsAccumulator_t freqTable[3];

void setup() {
  // NOTE: if not using PWM out, it should be held low to avoid tx noise
  pinMode(PWM_PIN, OUTPUT);
  digitalWrite(PWM_PIN, LOW);
  
  // prep the switch
  pinMode(SWITCH_PIN, INPUT_PULLUP);
  
  // set up the reset control pin
  pinMode(RESET_PIN, OUTPUT);
  digitalWrite(RESET_PIN, HIGH);
  
  Serial.begin(9600);

  // Query the HamShield for status information
  Serial.print("Radio status: ");
  int result = 0;
  result = radio.testConnection();
  Serial.println(result,DEC);
  
  // Tell the HamShield to start up
  radio.initialize();
  radio.setRfPower(0);
  radio.frequency(145500);
  // put your setup code here, to run once:
  //dds.setReferenceClock(34965/4);
  dds.start();
  freqTable[F_1200] = dds.calcFrequency(1200);
  freqTable[F_1500] = dds.calcFrequency(1500);
  freqTable[F_2400] = dds.calcFrequency(2400);
  dds.setFrequency(1000);
  dds.on();
  Serial.println("DDS on");
  delay(1000);
  dds.off();
  delay(2000);
  Serial.println("Next");
}

uint8_t code = MARTIN1;
bool parityCalc(int code) {  
     unsigned int v;       // word value to compute the parity of
     bool parity = false;  // parity will be the parity of v

    while (code)
    {
       parity = !parity;
       code = code & (code - 1);
    }

    return parity;
}

volatile bool registered = false;
volatile bool scanning = false;
volatile bool done = false;
volatile uint16_t nextBlock = 0;
volatile uint8_t currentScanline = 0;
volatile uint16_t scanline[2][20];

// Format is 3 'images', one each for green, blue and red
// But we don't have room, so it's monochrome
// 256 rows each
// 10 sets of 32 bits encoding on/off for the colour
//const unsigned long image[256][10] PROGMEM = {
 
//};

void loadScanline(uint8_t s, int y) {
  for(int i = 0; i < 20; i++) {
    scanline[s][i] = pgm_read_word_near(image + y*20 + i);
  }
}
#define DON()  PORTD |= _BV(2);
#define DOFF() PORTD &= ~_BV(2);
void loop() {
  // Load the first scanline
  loadScanline(0, 0);
  radio.setModeTransmit();
  delay(500);
  // VIS
  dds.playWait(1900,300);
  dds.playWait(1200,10);
  dds.playWait(1900,300);
  dds.playWait(1200,30);
  for(int x = 0; x < 7; x++) { 
     if(bitRead(code,x)) { dds.playWait(1100,30); } else { dds.playWait(1300,30); } 
  } 
  if(parityCalc(code)) { dds.playWait(1300,30); } else { dds.playWait(1100,30); } 
  dds.playWait(1200,30);
  dds.on();
  for(int y = 1; y < 256; y++){
    DON();
    dds.setPrecalcFrequency(freqTable[F_1200]);
    // Subtract for the timer ticks
    delayMicroseconds(3562);              // sync pulse (4862 uS)
    DOFF();
    DON();
    dds.setPrecalcFrequency(freqTable[F_1500]);
    // Subtract for the timer ticks
    delayMicroseconds(442);               // sync porch (572 uS)
    DOFF();
    scanning = true;
    for(uint8_t c = 0; c<3; c++) {
      scanning = true;
      while(!registered);
      registered = false;
      loadScanline((++currentScanline) & 1, y);
      while(!done);
      dds.setPrecalcFrequency(freqTable[F_1500]);
      done = false;
      scanning = false;
      DON();
      delayMicroseconds(442);               // color separator pulse (572 uS)
      DOFF();
    }
  }
  dds.off();
  radio.setModeReceive();
  delay(10000);
  return;
}

// The DDS is running faster than the pixel clock, so we
// only update the pixel frequency every few ticks.
ISR(ADC_vect) {
  static uint8_t tcnt = 0;
  static uint8_t shifts = 0;
  static uint8_t shiftingLine = 0;
  static uint8_t linePos = 0;
  static uint16_t pixelBlock;
  TIFR1 |= _BV(ICF1);
  dds.clockTick();
  if(scanning) {
    if(++tcnt == 8) {
      tcnt = 0;
      if(linePos == 21) {
        done = true;
        linePos = 0;
      }
      if(linePos == 0) {
        shifts = 0;
        shiftingLine = currentScanline&1;
        registered = true;
      }
      if(shifts == 0) {
        pixelBlock = scanline[shiftingLine][linePos++];
      }
      
      if(pixelBlock & 0x8000) {
        dds.setPrecalcFrequency(freqTable[F_2400]);
      } else {
        dds.setPrecalcFrequency(freqTable[F_1500]);
      }
      if(++shifts == 16) {
        shifts = 0;
      }
      pixelBlock <<= 1;
    }
  }
}

// Image is 256 lines * 320 pixels per line, packed to 16 bits at a time
const uint16_t image[256*20] PROGMEM = {
0xFFFF, 0xFFFF, 0xFFFF, 0xFFFF, 0xFFFF, 0xFFFF, 0xFFFF, 0xFFFF, 0xFFFF, 0xFFFF, 0xFFFF, 0xFFFF, 0xFFFF, 0xFFFF, 0xFFFF, 0xFFFF, 0xFFFF, 0xFFFF, 0xFFFF, 0xFFFF,  // Line 1
0xFFFF, 0xFFFF, 0xFFFF, 0xFFFF, 0xFFFF, 0xFFFF, 0xFFFF, 0xFFFF, 0xFFFF, 0xFFFF, 0xFFFF, 0xFFFF, 0xFFFF, 0xFFFF, 0xFFFF, 0xFFFF, 0xFFFF, 0xFFFF, 0xFFFF, 0xFFFF,  // Line 2
0xFFFF, 0xFFFF, 0xFFFF, 0xFFFF, 0xFFFF, 0xFFFF, 0xFFFF, 0xFFFF, 0xFFFF, 0xFFFF, 0xFFFF, 0xFFFF, 0xFFFF, 0xFFFF, 0xFFFF, 0xFFFF, 0xFFFF, 0xFFFF, 0xFFFF, 0xFFFF,  // Line 3
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0xFFFF, 0xFFFF, 0xFFFF, 0xFFFF, 0xFFFF, 0xFFFF, 0xFFFF, 0xFFFF, 0xFFFF, 0xFFFF, 0xFFFF, 0xFFFF, 0xFFFF, 0xFFFF, 0xFFFF, 0xFFFF, 0xFFFF, 0xFFFF, 0xFFFF, 0xFFFF,  // Line 256
};
