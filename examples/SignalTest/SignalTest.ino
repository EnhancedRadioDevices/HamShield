/* 

Plays back the current signal strength level and morses out it's call sign at the end.


*/

#define DOT 100
#define CALLSIGN "1ZZ9ZZ/B"

/* Standard libraries and variable init */

#include <HamShield.h>
#include <PCM.h>

#define PWM_PIN 3
#define RESET_PIN A3
#define SWITCH_PIN 2

HamShield radio;
int16_t rssi;
int peak = -150;
char sig[8];


/* Audio samples */

const unsigned char minus[] PROGMEM = {
130, 130, 130, 132, 134, 134, 135, 139, 141, 140, 141, 143,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 113, 
};

const unsigned char zero[] PROGMEM = {
123, 124, 123, 121, 122, 122, 121, 119, 117, 117, 117, 117,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 120, 
};

const unsigned char one[] PROGMEM = {
168, 161, 152, 142, 132, 126, 122, 121, 123, 125, 125, 124,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 115, 
};

const unsigned char two[] PROGMEM = {
104, 107, 113, 113, 115, 120, 120, 121, 125, 127, 122, 122,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 126, 
};

const unsigned char three[] PROGMEM = {
131, 129, 126, 130, 123, 128, 128, 127, 124, 130, 128, 129,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 126, 
};

const unsigned char four[] PROGMEM = {
125, 128, 125, 128, 127, 128, 130, 130, 124, 124, 129, 130,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 117, 
};

const unsigned char five[] PROGMEM = {
130, 126, 127, 130, 130, 125, 128, 129, 129, 130, 128, 128,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 125, 
};

const unsigned char six[] PROGMEM = {
116, 134, 134, 134, 121, 137, 127, 135, 128, 132, 119, 131,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 135, 
};

const unsigned char seven[] PROGMEM = {
134, 123, 132, 124, 127, 126, 123, 125, 124, 134, 123, 133,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 136, 
};

const unsigned char eight[] PROGMEM = {
104, 93, 82, 71, 61, 52, 41, 26, 14, 4, 0, 0,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 127, 
};

const unsigned char nine[] PROGMEM = {
129, 128, 129, 129, 129, 128, 128, 128, 128, 127, 128, 127,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 122, 
};

const unsigned char dbm[] PROGMEM = {
126, 127, 126, 128, 126, 128, 124, 126, 124, 129, 126, 133,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 129, 
};


/* get our radio ready */

void setup() {
  // NOTE: if not using PWM out, it should be held low to avoid tx noise
  pinMode(PWM_PIN, OUTPUT);
  digitalWrite(PWM_PIN, LOW);
  
  // prep the switch
  pinMode(SWITCH_PIN, INPUT_PULLUP);
  
  // set up the reset control pin
  pinMode(RESET_PIN, OUTPUT);
  digitalWrite(RESET_PIN, HIGH);
  
  Serial.begin(9600);
  Serial.print("Radio status: ");
  int result = radio.testConnection();
  Serial.println(result);
  radio.initialize();
  radio.frequency(446000);
  radio.setVolume1(0xF);
  radio.setVolume2(0xF);
  radio.setModeReceive();
  radio.setTxSourceMic();
  radio.setSQLoThresh(80);
  radio.setSQOn();
}

/* main program loop */


void loop() {
   rssi = radio.readRSSI();
   if(rssi > -120) { 
     for(;;) { 
          rssi = radio.readRSSI();
          if(rssi < -120) { break; } 
          if(rssi > peak) { peak = rssi;  Serial.print("New peak: "); Serial.println(rssi); }
     }
   }
     
   if(rssi < -120) { 
     Serial.println("Transmit On");
     radio.setModeTransmit();
     delay(250);
     tone(11,1000,500); 
     delay(1000);
     itoa(peak,sig,10);
     Serial.print(sig);
     Serial.print(" dBm...");
     for(int x = 0; x < strlen(sig); x++) { 
       if(sig[x] = '0') { startPlayback(zero, sizeof(zero)); }
       if(sig[x] = '1') { startPlayback(one, sizeof(one)); }
       if(sig[x] = '2') { startPlayback(two, sizeof(two)); }
       if(sig[x] = '3') { startPlayback(three, sizeof(three)); }
       if(sig[x] = '4') { startPlayback(four, sizeof(four)); }
       if(sig[x] = '5') { startPlayback(five, sizeof(five)); }
       if(sig[x] = '6') { startPlayback(six, sizeof(six)); }
       if(sig[x] = '7') { startPlayback(seven, sizeof(seven)); }
       if(sig[x] = '8') { startPlayback(eight, sizeof(eight)); }       
       if(sig[x] = '9') { startPlayback(nine, sizeof(nine)); }     
       if(sig[x] = '-') { startPlayback(minus, sizeof(minus)); }  
       delay(1000);
     }
     startPlayback(dbm,sizeof(dbm));
     delay(2000);  
     tone(11,1000,500); 
     delay(1000);
     Serial.println("done!");
     radio.morseOut(CALLSIGN);
     radio.setModeReceive();
     Serial.println("Transmit off");
     delay(1000);
   }
}

